// AUTO GENERATED STRESS RANDOM FOREST

#define STRESS_TREE_COUNT 20

// TREE 0

const int stress_feature_0[] = {1,3,2,0,2,2,3,0,-2,-2,0,-2,-2,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-2,-2};

const float stress_threshold_0[] = {0.3283901810646057,0.9254133105278015,34.776573181152344,0.16710028052330017,33.39952087402344,32.88430404663086,0.9157594740390778,0.15144827216863632,-2.0,-2.0,0.145772323012352,-2.0,-2.0,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-2.0,-2.0};

const int stress_left_0[] = {1,2,3,4,5,6,7,8,-1,-1,11,-1,-1,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-1,-1};

const int stress_right_0[] = {214,95,60,55,24,13,10,9,-1,-1,12,-1,-1,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-1,-1};

const int stress_value_0[] = {0,0,0,0,0,3,0,1,1,1,0,0,0,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1,1};

// TREE 1

const int stress_feature_1[] = {2,3,0,2,0,2,-2,-2,-2,2,-2,-2,0,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-2,-2};

const float stress_threshold_1[] = {33.98305130004883,0.9581575095653534,0.0913432314991951,31.55753803253174,0.08533470705151558,31.32968521118164,-2.0,-2.0,-2.0,32.96798133850098,-2.0,-2.0,0.16987594217061996,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-2.0,-2.0};

const int stress_left_1[] = {1,2,3,4,5,6,-1,-1,-1,10,-1,-1,13,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-1,-1};

const int stress_right_1[] = {118,85,12,9,8,7,-1,-1,-1,11,-1,-1,78,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-1,-1};

const int stress_value_1[] = {0,0,0,2,1,1,1,1,1,2,2,2,0,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1,1};

// TREE 2

const int stress_feature_2[] = {0,3,3,2,2,1,0,-2,0,-2,-2,3,2,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-2,-2};

const float stress_threshold_2[] = {0.1708678901195526,0.9254297018051147,0.9167072772979736,34.39651107788086,33.37070274353027,0.27685074508190155,0.12614156678318977,-2.0,0.14162932336330414,-2.0,-2.0,0.9112050533294678,32.857248306274414,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-2.0,-2.0};

const int stress_left_2[] = {1,2,3,4,5,6,7,-1,9,-1,-1,12,13,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-1,-1};

const int stress_right_2[] = {276,125,36,29,16,11,8,-1,10,-1,-1,15,14,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-1,-1};

const int stress_value_2[] = {0,0,0,0,0,1,2,0,2,3,2,1,1,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1,1};

// TREE 3

const int stress_feature_3[] = {1,0,2,3,-2,-2,0,1,3,-2,-2,-2,2,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-2,-2};

const float stress_threshold_3[] = {0.3213978558778763,0.08624324947595596,31.30733013153076,0.9305185973644257,-2.0,-2.0,0.06484958156943321,0.1142064779996872,0.9286591410636902,-2.0,-2.0,-2.0,35.48092460632324,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-2.0,-2.0};

const int stress_left_3[] = {1,2,3,4,-1,-1,7,8,9,-1,-1,-1,13,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-1,-1};

const int stress_right_3[] = {222,29,6,5,-1,-1,12,11,10,-1,-1,-1,28,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-1,-1};

const int stress_value_3[] = {0,0,3,1,1,1,3,2,2,2,2,3,3,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1,1};

// TREE 4

const int stress_feature_4[] = {1,2,1,1,-2,3,0,3,-2,-2,-2,-2,0,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-2,-2};

const float stress_threshold_4[] = {0.32828177511692047,33.984479904174805,0.13688278943300247,0.12142376229166985,-2.0,0.9524759650230408,0.08548267185688019,0.9287529587745667,-2.0,-2.0,-2.0,-2.0,0.08892499655485153,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-2.0,-2.0};

const int stress_left_4[] = {1,2,3,4,-1,6,7,8,-1,-1,-1,-1,13,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-1,-1};

const int stress_right_4[] = {204,75,12,5,-1,11,10,9,-1,-1,-1,-1,22,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-1,-1};

const int stress_value_4[] = {0,0,0,3,2,3,1,1,1,1,0,3,0,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1,1};

// TREE 5

const int stress_feature_5[] = {2,0,1,-2,3,1,3,-2,-2,-2,1,2,-2,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-2,-2};

const float stress_threshold_5[] = {33.96093559265137,0.09163694083690643,0.12013925984501839,-2.0,0.9496378004550934,0.17116591334342957,0.9279866814613342,-2.0,-2.0,-2.0,0.21352265775203705,31.319686889648438,-2.0,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-2.0,-2.0};

const int stress_left_5[] = {1,2,3,-1,5,6,7,-1,-1,-1,11,12,-1,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-1,-1};

const int stress_right_5[] = {116,21,4,-1,10,9,8,-1,-1,-1,14,13,-1,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-1,-1};

const int stress_value_5[] = {0,0,3,2,3,1,1,1,1,2,3,3,3,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1,1};

// TREE 6

const int stress_feature_6[] = {0,2,1,3,1,-2,3,-2,-2,-2,3,0,1,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-2,-2};

const float stress_threshold_6[] = {0.17748822271823883,33.994869232177734,0.13968893140554428,0.9546152055263519,0.12009521201252937,-2.0,0.9307275116443634,-2.0,-2.0,-2.0,0.9581575095653534,0.09169857576489449,0.218671016395092,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-2.0,-2.0};

const int stress_left_6[] = {1,2,3,4,5,-1,7,-1,-1,-1,11,12,13,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-1,-1};

const int stress_right_6[] = {198,71,10,9,6,-1,8,-1,-1,-1,50,15,14,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-1,-1};

const int stress_value_6[] = {0,0,0,3,2,2,1,1,0,3,0,0,2,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1,1};

// TREE 7

const int stress_feature_7[] = {0,3,1,2,2,3,1,2,-2,-2,3,-2,-2,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-2,-2};

const float stress_threshold_7[] = {0.17102137953042984,0.924545556306839,0.2655981332063675,34.78295707702637,34.19167900085449,0.9191128313541412,0.25798122584819794,33.25933074951172,-2.0,-2.0,0.9133956134319305,-2.0,-2.0,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-2.0,-2.0};

const int stress_left_7[] = {1,2,3,4,5,6,7,8,-1,-1,11,-1,-1,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-1,-1};

const int stress_right_7[] = {240,107,40,37,22,13,10,9,-1,-1,12,-1,-1,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-1,-1};

const int stress_value_7[] = {0,0,0,0,0,0,0,0,0,0,0,2,0,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1,1};

// TREE 8

const int stress_feature_8[] = {0,2,3,2,3,2,-2,0,-2,3,-2,3,-2,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-2,-2};

const float stress_threshold_8[] = {0.1708678901195526,34.80713653564453,0.9228534698486328,33.36261558532715,0.9161269664764404,32.81829261779785,-2.0,0.1305425502359867,-2.0,0.911093682050705,-2.0,0.9158236682415009,-2.0,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-2.0,-2.0};

const int stress_left_8[] = {1,2,3,4,5,6,-1,8,-1,10,-1,12,-1,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-1,-1};

const int stress_right_8[] = {234,173,68,21,14,7,-1,9,-1,11,-1,13,-1,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-1,-1};

const int stress_value_8[] = {0,0,0,0,2,2,1,2,0,2,2,2,2,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1,1};

// TREE 9

const int stress_feature_9[] = {1,3,2,2,1,1,3,-2,-2,0,-2,1,-2,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-2,-2};

const float stress_threshold_9[] = {0.32171498239040375,0.9254297018051147,34.775774002075195,33.542789459228516,0.24929913878440857,0.24111852794885635,0.9165575504302979,-2.0,-2.0,0.12220311164855957,-2.0,0.2458101511001587,-2.0,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-2.0,-2.0};

const int stress_left_9[] = {1,2,3,4,5,6,7,-1,-1,10,-1,12,-1,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-1,-1};

const int stress_right_9[] = {204,103,78,41,14,9,8,-1,-1,11,-1,13,-1,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-1,-1};

const int stress_value_9[] = {0,0,0,0,0,0,0,0,2,0,0,0,0,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1,1};

// TREE 10

const int stress_feature_10[] = {0,3,3,2,2,3,2,-2,2,0,-2,-2,1,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-2,-2};

const float stress_threshold_10[] = {0.17815862596035004,0.9255498349666595,0.9208007156848907,34.434879302978516,33.36498260498047,0.9165762662887573,32.80031394958496,-2.0,33.06846237182617,0.12872034683823586,-2.0,-2.0,0.2897941917181015,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-2.0,-2.0};

const int stress_left_10[] = {1,2,3,4,5,6,7,-1,9,10,-1,-1,13,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-1,-1};

const int stress_right_10[] = {282,135,78,47,22,17,8,-1,12,11,-1,-1,16,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-1,-1};

const int stress_value_10[] = {0,0,0,0,0,2,2,1,2,0,0,3,2,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1,1};

// TREE 11

const int stress_feature_11[] = {1,3,3,0,1,2,-2,-2,2,2,-2,2,-2,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-2,-2};

const float stress_threshold_11[] = {0.33308045566082,0.9254133105278015,0.9169614911079407,0.14962540566921234,0.2574407607316971,33.371761322021484,-2.0,-2.0,33.376861572265625,33.055830001831055,-2.0,33.2404727935791,-2.0,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-2.0,-2.0};

const int stress_left_11[] = {1,2,3,4,5,6,-1,-1,9,10,-1,12,-1,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-1,-1};

const int stress_right_11[] = {276,131,40,29,8,7,-1,-1,14,11,-1,13,-1,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-1,-1};

const int stress_value_11[] = {0,0,0,0,0,0,0,0,0,2,3,2,2,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1,1};

// TREE 12

const int stress_feature_12[] = {0,2,0,3,2,3,-2,-2,3,-2,-2,1,-2,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-2,-2};

const float stress_threshold_12[] = {0.170767143368721,33.99166488647461,0.08733905479311943,0.9534350037574768,31.530466079711914,0.9306740164756775,-2.0,-2.0,0.925435334444046,-2.0,-2.0,0.2135491669178009,-2.0,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-2.0,-2.0};

const int stress_left_12[] = {1,2,3,4,5,6,-1,-1,9,-1,-1,12,-1,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-1,-1};

const int stress_right_12[] = {244,115,16,11,8,7,-1,-1,10,-1,-1,13,-1,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-1,-1};

const int stress_value_12[] = {0,0,0,3,2,1,1,1,2,2,2,3,3,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1,1};

// TREE 13

const int stress_feature_13[] = {0,0,2,-2,3,2,2,-2,2,1,-2,-2,-2,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-2,-2};

const float stress_threshold_13[] = {0.1708678901195526,0.08624324947595596,31.28901195526123,-2.0,0.9427103102207184,35.19927406311035,31.530466079711914,-2.0,34.622623443603516,0.12775151431560516,-2.0,-2.0,-2.0,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-2.0,-2.0};

const int stress_left_13[] = {1,2,3,-1,5,6,7,-1,9,10,-1,-1,-1,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-1,-1};

const int stress_right_13[] = {222,19,4,-1,14,13,8,-1,12,11,-1,-1,-1,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-1,-1};

const int stress_value_13[] = {0,0,3,1,3,2,2,1,2,2,2,2,2,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1,1};

// TREE 14

const int stress_feature_14[] = {2,0,3,1,-2,2,1,-2,-2,-2,0,-2,2,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-2,-2};

const float stress_threshold_14[] = {33.97149658203125,0.08952147886157036,0.9522142708301544,0.11889089271426201,-2.0,32.00844955444336,0.12664348632097244,-2.0,-2.0,-2.0,0.08616691827774048,-2.0,33.0821647644043,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-2.0,-2.0};

const int stress_left_14[] = {1,2,3,4,-1,6,7,-1,-1,-1,11,-1,13,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-1,-1};

const int stress_right_14[] = {102,17,10,5,-1,9,8,-1,-1,-1,12,-1,16,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-1,-1};

const int stress_value_14[] = {0,0,3,2,2,1,1,1,1,2,3,3,3,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1,1};

// TREE 15

const int stress_feature_15[] = {1,3,1,2,-2,-2,2,0,2,2,2,2,3,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-2,-2};

const float stress_threshold_15[] = {0.319911390542984,0.9231257438659668,0.23198137432336807,34.446550369262695,-2.0,-2.0,34.73392295837402,0.16653823852539062,33.371761322021484,33.0970344543457,32.87862014770508,31.982802391052246,0.9111858904361725,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-2.0,-2.0};

const int stress_left_15[] = {1,2,3,4,-1,-1,7,8,9,10,11,12,13,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-1,-1};

const int stress_right_15[] = {240,73,6,5,-1,-1,52,49,26,19,16,15,14,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-1,-1};

const int stress_value_15[] = {0,0,0,0,0,0,0,0,0,2,3,1,1,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1,1};

// TREE 16

const int stress_feature_16[] = {0,3,1,1,3,-2,-2,3,-2,-2,3,2,2,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-2,-2};

const float stress_threshold_16[] = {0.17738129943609238,0.9250653982162476,0.2163899913430214,0.19045650959014893,0.9208371341228485,-2.0,-2.0,0.9071032106876373,-2.0,-2.0,0.9228534698486328,34.73170471191406,33.36498260498047,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-2.0,-2.0};

const int stress_left_16[] = {1,2,3,4,5,-1,-1,8,-1,-1,11,12,13,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-1,-1};

const int stress_right_16[] = {212,93,10,7,6,-1,-1,9,-1,-1,64,51,28,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-1,-1};

const int stress_value_16[] = {0,0,0,0,0,0,0,0,0,0,0,0,0,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1,1};

// TREE 17

const int stress_feature_17[] = {1,2,3,0,2,3,-2,-2,2,-2,-2,3,3,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-2,-2};

const float stress_threshold_17[] = {0.3213978558778763,33.96065330505371,0.95846888422966,0.09179330617189407,31.537007331848145,0.9308036863803864,-2.0,-2.0,32.968997955322266,-2.0,-2.0,0.9255509674549103,0.9213168025016785,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-2.0,-2.0};

const int stress_left_17[] = {1,2,3,4,5,6,-1,-1,9,-1,-1,12,13,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-1,-1};

const int stress_right_17[] = {218,87,64,11,8,7,-1,-1,10,-1,-1,45,30,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-1,-1};

const int stress_value_17[] = {0,0,0,0,2,1,1,0,2,2,2,0,0,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1,1};

// TREE 18

const int stress_feature_18[] = {0,2,1,3,1,-2,2,-2,3,-2,-2,-2,3,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-2,-2};

const float stress_threshold_18[] = {0.17738129943609238,34.02612113952637,0.1396576315164566,0.9540489912033081,0.11996260285377502,-2.0,31.060754776000977,-2.0,0.9286762177944183,-2.0,-2.0,-2.0,0.9595871269702911,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-2.0,-2.0};

const int stress_left_18[] = {1,2,3,4,5,-1,7,-1,9,-1,-1,-1,13,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-1,-1};

const int stress_right_18[] = {208,79,12,11,6,-1,8,-1,10,-1,-1,-1,50,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-1,-1};

const int stress_value_18[] = {0,0,0,3,1,2,1,0,1,1,1,3,0,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1,1};

// TREE 19

const int stress_feature_19[] = {0,3,1,3,1,-2,-2,2,-2,-2,0,2,2,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-2,-2};

const float stress_threshold_19[] = {0.17075111716985703,0.9254847168922424,0.2254580557346344,0.9226105511188507,0.22344385832548141,-2.0,-2.0,34.323251724243164,-2.0,-2.0,0.1143052987754345,34.7874641418457,34.39218330383301,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-2.0,-2.0};

const int stress_left_19[] = {1,2,3,4,5,-1,-1,8,-1,-1,11,12,13,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-1,-1};

const int stress_right_19[] = {206,75,10,7,6,-1,-1,9,-1,-1,30,29,24,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-1,-1};

const int stress_value_19[] = {0,0,0,0,0,0,0,2,2,0,0,2,0,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1,1};

